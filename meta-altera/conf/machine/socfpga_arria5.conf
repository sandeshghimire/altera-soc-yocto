## meta-altera/conf/machine/socfpga_arria5.conf
```bitbake
#@TYPE: Machine
#@NAME: socfpga
#@DESCRIPTION: Machine configuration for Altera socfpga5xs1 based systems

MACHINE_FEATURES = "serial rtc"
DISTRO_FEATURES = " ${DISTRO_FEATURES_LIBC}"
MACHINE_DEFCONFIG = "socfpga_defconfig"

require conf/machine/include/tune-cortexa9.inc

UBOOT_MACHINE = "socfpga_arria5_config"
UBOOT_ENTRYPOINT = "0x00008000"

hostname="socfpga"
KMACHINE = "socfpga_arria5"
KERNEL_IMAGETYPE = "zImage"
SERIAL_CONSOLE = "115200 ttyS0"

IMAGE_FSTYPES ?= "ext3 tar.gz"

EXTRA_IMAGECMD_jffs2 ?= "--pad --little-endian --eraseblock=0x10000 --pagesize=0x100"
ROOT_FLASH_SIZE = "16"
```
